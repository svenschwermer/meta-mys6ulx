## conf/layer.conf
```bitbake
# We have a conf and classes directory, add to BBPATH
BBPATH .= ":${LAYERDIR}"

# We have recipes-* directories, add to BBFILES
BBFILES += "${LAYERDIR}/recipes-*/*/*.bb \
            ${LAYERDIR}/recipes-*/*/*.bbappend"

BBFILE_COLLECTIONS += "../meta-mys6ulx"
BBFILE_PATTERN_../meta-mys6ulx = "^${LAYERDIR}/"
BBFILE_PRIORITY_../meta-mys6ulx = "6"
```

## conf/machine/mys6ulx.conf
```bitbake
#@TYPE: Machine
#@NAME: MYiR MYS-6ULX
#@SOC: i.MX6ULL
#@DESCRIPTION: Machine configuration for MYiR MYS-6ULX
#@MAINTAINER: Sven Schwermer <sven@svenschwermer.de>

MACHINEOVERRIDES =. "mx6:mx6ull:"

include conf/machine/include/imx-base.inc
include conf/machine/include/tune-cortexa7.inc

KERNEL_DEVICETREE = "imx6ull-mys6ulx.dtb"

UBOOT_CONFIG ??= "sd"
UBOOT_CONFIG[sd] = "mys6ulx_config,sdcard"
UBOOT_CONFIG[mfgtool] = "mys6ulx_config"

PREFERRED_PROVIDER_u-boot = "u-boot-myir"
PREFERRED_PROVIDER_virtual/bootloader = "u-boot-myir"
PREFERRED_PROVIDER_virtual/kernel = "linux-stable"

SERIAL_CONSOLE = "115200 ttymxc0"

MACHINE_FEATURES += "wifi bluetooth"
```

## recipes-bsp/u-boot/files/myir/mys6ulx/Kconfig
```kconfig
if TARGET_MYS6ULX

config SYS_BOARD
	default "mys6ulx"

config SYS_VENDOR
	default "myir"

config SYS_CONFIG_NAME
	default "mys6ulx"

config IMX_CONFIG
	default "board/myir/mys6ulx/imximage.cfg"

endif
```

## recipes-bsp/u-boot/files/mys6ulx_defconfig
```kconfig
CONFIG_ARM=y
CONFIG_ARCH_MX6=y
CONFIG_SYS_TEXT_BASE=0x87800000
CONFIG_TARGET_MYS6ULX=y
CONFIG_DEFAULT_DEVICE_TREE="imx6ull-mys6ulx"
CONFIG_DISTRO_DEFAULTS=y
CONFIG_NAND_BOOT=y
CONFIG_SD_BOOT=y
CONFIG_BOOTCOMMAND="run bootcmd"
CONFIG_BOARD_EARLY_INIT_F=y
CONFIG_CMD_GPIO=y
CONFIG_CMD_MMC=y
CONFIG_OF_CONTROL=y
CONFIG_NET_RANDOM_ETHADDR=y
CONFIG_CLK_IMX=y
CONFIG_CLK_IMX6UL=y
CONFIG_DM_GPIO=y
CONFIG_DM_MMC=y
CONFIG_FSL_ESDHC=y
CONFIG_PHYLIB=y
CONFIG_PHY_SMSC=y
CONFIG_DM_ETH=y
CONFIG_FEC_MXC=y
CONFIG_PHY=y
CONFIG_PINCTRL=y
CONFIG_PINCTRL_IMX6=y
CONFIG_MXC_UART=y
CONFIG_IMX_THERMAL=y
```
